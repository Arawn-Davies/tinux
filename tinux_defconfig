## tinux_defconfig
```kconfig
BR2_x86_i486=y
BR2_CCACHE=y
BR2_OPTIMIZE_FAST=y
BR2_KERNEL_HEADERS_4_19=y
BR2_TOOLCHAIN_BUILDROOT_LOCALE=y
BR2_PTHREAD_DEBUG=y
BR2_TOOLCHAIN_BUILDROOT_USE_SSP=y
BR2_GCC_VERSION_8_X=y
BR2_TOOLCHAIN_BUILDROOT_CXX=y
BR2_TARGET_GENERIC_HOSTNAME="tinux"
BR2_TARGET_GENERIC_ISSUE="Welcome to Tinux"
BR2_TARGET_GENERIC_ROOT_PASSWD="changeme"
BR2_LINUX_KERNEL=y
BR2_LINUX_KERNEL_DEFCONFIG="tinux"
BR2_LINUX_KERNEL_INSTALL_TARGET=y
BR2_PACKAGE_BZIP2=y
BR2_PACKAGE_P7ZIP=y
BR2_PACKAGE_UNRAR=y
BR2_PACKAGE_XZ=y
BR2_PACKAGE_ZIP=y
BR2_PACKAGE_GDB=y
BR2_PACKAGE_GDB_DEBUGGER=y
BR2_PACKAGE_GDB_TUI=y
BR2_PACKAGE_BINUTILS=y
BR2_PACKAGE_BINUTILS_TARGET=y
BR2_PACKAGE_FLEX=y
BR2_PACKAGE_GIT=y
BR2_PACKAGE_MAKE=y
BR2_PACKAGE_TREE=y
BR2_PACKAGE_CPIO=y
BR2_PACKAGE_DOSFSTOOLS=y
BR2_PACKAGE_DOSFSTOOLS_FATLABEL=y
BR2_PACKAGE_DOSFSTOOLS_FSCK_FAT=y
BR2_PACKAGE_DOSFSTOOLS_MKFS_FAT=y
BR2_PACKAGE_E2TOOLS=y
BR2_PACKAGE_EXFAT=y
BR2_PACKAGE_EXFAT_UTILS=y
BR2_PACKAGE_NTFS_3G=y
BR2_PACKAGE_NTFS_3G_NTFSPROGS=y
BR2_PACKAGE_UNIONFS=y
BR2_PACKAGE_CHOCOLATE_DOOM=y
BR2_PACKAGE_DOOM_WAD=y
BR2_PACKAGE_PRBOOM=y
BR2_PACKAGE_DIRECTFB=y
BR2_PACKAGE_DIRECTFB_MULTI=y
BR2_PACKAGE_DIRECTFB_TIFF=y
BR2_PACKAGE_DIRECTFB_EXAMPLES=y
BR2_PACKAGE_SDL2_DIRECTFB=y
BR2_PACKAGE_SDL2_GFX=y
BR2_PACKAGE_SDL2_IMAGE=y
BR2_PACKAGE_SDL2_MIXER=y
BR2_PACKAGE_SDL2_NET=y
BR2_PACKAGE_SDL2_TTF=y
BR2_PACKAGE_XORG7=y
BR2_PACKAGE_DILLO=y
BR2_PACKAGE_XTERM=y
BR2_PACKAGE_OPENBOX=y
BR2_PACKAGE_MEMTEST86=y
BR2_PACKAGE_XORRISO=y
BR2_PACKAGE_LIBARCHIVE=y
BR2_PACKAGE_LIBARCHIVE_BSDTAR=y
BR2_PACKAGE_LIBARCHIVE_BSDCPIO=y
BR2_PACKAGE_LIBZIP=y
BR2_PACKAGE_LIBLOCKFILE=y
BR2_PACKAGE_LIBFTDI=y
BR2_PACKAGE_LIBFTDI_CPP=y
BR2_PACKAGE_LIBFTDI1=y
BR2_PACKAGE_LIBFTDI1_LIBFTDIPP1=y
BR2_PACKAGE_LIBFTDI1_FDTI_EEPROM=y
BR2_PACKAGE_LIBSERIAL=y
BR2_PACKAGE_LIBSERIALPORT=y
BR2_PACKAGE_NCURSES_WCHAR=y
BR2_PACKAGE_NCURSES_TARGET_PROGS=y
BR2_PACKAGE_LINUX_SYSCALL_SUPPORT=y
BR2_PACKAGE_QEMU=y
BR2_PACKAGE_QEMU_CUSTOM_TARGETS="i386-softmmu"
BR2_PACKAGE_QEMU_SDL=y
# BR2_PACKAGE_IFUPDOWN_SCRIPTS is not set
BR2_PACKAGE_PUTTY=y
BR2_PACKAGE_FILE=y
BR2_PACKAGE_SCREEN=y
BR2_PACKAGE_SUDO=y
BR2_PACKAGE_TMUX=y
BR2_PACKAGE_NANO=y
BR2_TARGET_ROOTFS_ISO9660=y
BR2_TARGET_GRUB2=y
```
